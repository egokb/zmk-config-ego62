## config/boards/arm/ego46/Kconfig.board
```kconfig
#
# Copyright (c) 2021 Polarity Works
# SPDX-License-Identifier: MIT
#

config BOARD_EGO46_DONGLE
	bool "ego46_dongle"
	depends on SOC_NRF52840_QIAA
	
config BOARD_EGO46_LEFT
	bool "ego46_left"
	depends on SOC_NRF52840_QIAA

config BOARD_EGO46_RIGHT
	bool "ego46_right"
	depends on SOC_NRF52840_QIAA
```

## config/boards/arm/ego46/Kconfig.defconfig
```kconfig
# BlueMicro840 board configuration

# Copyright (c) 2020 Pete Johanson, Derek Schmell
# SPDX-License-Identifier: MIT

if BOARD_EGO46_DONGLE
    config ZMK_KEYBOARD_NAME
    default "ego46"
endif

if BOARD_EGO46_LEFT
    config ZMK_KEYBOARD_NAME
    default "ego46_left"
endif

if BOARD_EGO46_RIGHT
    config ZMK_KEYBOARD_NAME
    default "ego46_right"
endif

if BOARD_EGO46_DONGLE || BOARD_EGO46_LEFT || BOARD_EGO46_RIGHT

    config BOARD
        default "ego46"

    config ZMK_SPLIT
        default y

    config SPI
        bool
        default y

    config BT_CTLR
    	default BT
    
    config ZMK_BLE
    	default y
    
    config ZMK_USB
    	default y

    if USB
    
        config USB_NRFX
        	default y
        
        config USB_DEVICE_STACK
        	default y
    
    endif # USB

    config ZMK_BATTERY_VOLTAGE_DIVIDER
    	default y
    
    config SPI
    	default y
endif
```

## config/boards/arm/ego62/Kconfig
```kconfig
# SPDX-License-Identifier: MIT

config BOARD_ENABLE_DCDC
	bool "Enable DCDC mode"
	select SOC_DCDC_NRF52X
	default y
	depends on BOARD_EGO62_DONGLE || BOARD_EGO62_LEFT || BOARD_EGO62_RIGHT
```

## config/boards/arm/ego62/Kconfig.board
```kconfig
#
# Copyright (c) 2021 Polarity Works
# SPDX-License-Identifier: MIT
#

config BOARD_EGO62_DONGLE
	bool "ego62_dongle"
	depends on SOC_NRF52840_QIAA
	
config BOARD_EGO62_LEFT
	bool "ego62_left"
	depends on SOC_NRF52840_QIAA

config BOARD_EGO62_RIGHT
	bool "ego62_right"
	depends on SOC_NRF52840_QIAA
```

## config/boards/arm/ego62/Kconfig.defconfig
```kconfig
# BlueMicro840 board configuration

# Copyright (c) 2020 Pete Johanson, Derek Schmell
# SPDX-License-Identifier: MIT

if BOARD_EGO62_DONGLE
    config ZMK_KEYBOARD_NAME
    default "ego62"
endif

if BOARD_EGO62_LEFT
    config ZMK_KEYBOARD_NAME
    default "ego62_left"
endif

if BOARD_EGO62_RIGHT
    config ZMK_KEYBOARD_NAME
    default "ego62_right"
endif

if BOARD_EGO62_DONGLE || BOARD_EGO62_LEFT || BOARD_EGO62_RIGHT

    config BOARD
        default "ego62"

    config ZMK_SPLIT
        default y

    config SPI
        bool
        default y

    config BT_CTLR
    	default BT
    
    config ZMK_BLE
    	default y
    
    config ZMK_USB
    	default y

    if USB
    
        config USB_NRFX
        	default y
        
        config USB_DEVICE_STACK
        	default y
    
    endif # USB

    config ZMK_BATTERY_VOLTAGE_DIVIDER
    	default y
    
    config SPI
    	default y
endif
```

## config/boards/arm/ego_controller/Kconfig.defconfig
```kconfig
# Copyright (c) 2021 The ZMK Contributors
# SPDX-License-Identifier: MIT

if BOARD_EGO_CONTROLLER

config BOARD
    default "ego_controller"

if USB_DEVICE_STACK

config USB_NRFX
    default y

endif # USB_DEVICE_STACK

config BT_CTLR
    default BT

endif # BOARD_EGO_CONTROLLER
```

## config/boards/arm/egokb_control/Kconfig.board
```kconfig
#
# Copyright (c) 2021 Polarity Works
# SPDX-License-Identifier: MIT
#

config BOARD_EGOKB_CONTROL
	bool "egokb_control"
	depends on SOC_NRF52840_QIAA
```

## config/boards/arm/egokb_control/Kconfig.defconfig
```kconfig
# BlueMicro840 board configuration

# Copyright (c) 2020 Pete Johanson, Derek Schmell
# SPDX-License-Identifier: MIT

if BOARD_EGOKB_CONTROL
    config ZMK_KEYBOARD_NAME
        default "egokb"

    config BOARD
        default "egokb_control"

    config ZMK_SPLIT
        default y

    config BT_CTLR
    	default BT
    
    config ZMK_BLE
    	default y
    
    config ZMK_USB
    	default y

    if USB
    
        config USB_NRFX
        	default y
        
        config USB_DEVICE_STACK
        	default y
    
    endif # USB

    config ZMK_BATTERY_VOLTAGE_DIVIDER
    	default y
endif
```

## config/boards/arm/flkb/Kconfig
```kconfig
# SPDX-License-Identifier: MIT

config BOARD_ENABLE_DCDC
	bool "Enable DCDC mode"
	select SOC_DCDC_NRF52X
	default y
	depends on BOARD_EGO46_DONGLE || BOARD_EGO46_LEFT || BOARD_EGO46_RIGHT
```

## config/boards/egokb/egokb_control/Kconfig.defconfig
```kconfig
# Copyright (c) 2020 The ZMK Contributors
# SPDX-License-Identifier: MIT

if BOARD_EGOKB_CONTROL

config BOARD
	default "egokb_control"

if USB_DEVICE_STACK

config USB_NRFX
	default y

endif # USB_DEVICE_STACK

config BT_CTLR
	default BT

endif
```

## config/boards/egokb/egokb_control/Kconfig.egokb_control
```kconfig
# Copyright (c) 2020 The ZMK Contributors
# SPDX-License-Identifier: MIT

config BOARD_EGOKB_CONTROL
    bool "Ego62 Control Board"
    select SOC_NRF52840_QIAA
```

## config/boards/egokb/egokb_control/board.yml
```yaml
board:
  name: egokb_control
  vendor: egokb
  socs:
    - name: nrf52840
      variants:
        - name: zmk
  revision:
    format: major.minor.patch
    default: 1.0.0
    revisions:
      - name: 1.0.0
```

## config/boards/egokb/egokb_control/egokb_control_nrf52840_zmk_1_0_0_defconfig
```kconfig
#
# Copyright (c) 2024 The ZMK Contributors
# SPDX-License-Identifier: MIT
#

# ZMK-specific defaults for egokb_control

# UF2 output format for easy flashing
CONFIG_BUILD_OUTPUT_UF2=y

# ZMK USB
CONFIG_ZMK_USB=y

# ZMK BLE
CONFIG_ZMK_BLE=y
```

## config/boards/shields/ego62/Kconfig.defconfig
```kconfig
# Copyright (c) 2020 Pete Johanson, Kurtis Lew
# SPDX-License-Identifier: MIT

if SHIELD_EGO62_DONGLE

config ZMK_KEYBOARD_NAME
    default "ego62"

config ZMK_SPLIT_ROLE_CENTRAL
    default y

config ZMK_SPLIT_BLE_CENTRAL_PERIPHERALS
    default 2

endif

if SHIELD_EGO62_DONGLE || SHIELD_EGO62_LEFT || SHIELD_EGO62_RIGHT

config ZMK_SPLIT
    default y

endif
```

## config/boards/shields/ego62/Kconfig.shield
```kconfig
# Copyright (c) 2020 Pete Johanson, Kurtis Lew
# SPDX-License-Identifier: MIT

config SHIELD_EGO62_DONGLE
    def_bool $(shields_list_contains,ego62_dongle)

config SHIELD_EGO62_LEFT
    def_bool $(shields_list_contains,ego62_left)

config SHIELD_EGO62_RIGHT
    def_bool $(shields_list_contains,ego62_right)
```
