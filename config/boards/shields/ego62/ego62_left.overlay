/*
 * Copyright (c) 2020 The ZMK Contributors
 *
 * SPDX-License-Identifier: MIT
 */

#include "ego62.dtsi"

&physical_layout0 {
    transform = <&default_transform>;
    kscan = <&kscan0>;
};

&kscan0 {
	row-gpios
			= <&gpio0 17 GPIO_ACTIVE_HIGH>
			, <&gpio0 15 GPIO_ACTIVE_HIGH>
			, <&gpio0 24 GPIO_ACTIVE_HIGH>
			, <&gpio0 20 GPIO_ACTIVE_HIGH>
			, <&gpio1 2  GPIO_ACTIVE_HIGH>
			;

   	col-gpios
			= <&gpio1 0  (GPIO_ACTIVE_HIGH | GPIO_PULL_DOWN)>
			, <&gpio0 22 (GPIO_ACTIVE_HIGH | GPIO_PULL_DOWN)>
			, <&gpio0 13 (GPIO_ACTIVE_HIGH | GPIO_PULL_DOWN)>
			, <&gpio1 4  (GPIO_ACTIVE_HIGH | GPIO_PULL_DOWN)>
			, <&gpio0 9  (GPIO_ACTIVE_HIGH | GPIO_PULL_DOWN)>
			, <&gpio1 6  (GPIO_ACTIVE_HIGH | GPIO_PULL_DOWN)>
			, <&gpio0 10 (GPIO_ACTIVE_HIGH | GPIO_PULL_DOWN)>
			;
};
